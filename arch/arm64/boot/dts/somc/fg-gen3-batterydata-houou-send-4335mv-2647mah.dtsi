/* Copyright (c) 2016, The Linux Foundation. All rights reserved.
 *
 * This program is free software; you can redistribute it and/or modify
 * it under the terms of the GNU General Public License version 2 and
 * only version 2 as published by the Free Software Foundation.
 *
 * This program is distributed in the hope that it will be useful,
 * but WITHOUT ANY WARRANTY; without even the implied warranty of
 * MERCHANTABILITY or FITNESS FOR A PARTICULAR PURPOSE.  See the
 * GNU General Public License for more details.
 */
/*
 * Copyright (C) 2018 Sony Mobile Communications Inc.
 *
 * This program is free software; you can redistribute it and/or modify
 * it under the terms of the GNU General Public License version 2, as
 * published by the Free Software Foundation.
 */

qcom,send_2647mah {
	qcom, = <24>;
	somc,initial-capacity-uah = <2820000>;
	qcom,max-voltage-uv = <4335000>;
	qcom,fg-cc-cv-threshold-mv = <4325>;
	qcom,fastchg-current-ma = <2025>;
	qcom,nom-batt-capacity-mah = <2647>;
	qcom,batt-id-kohm = <330>;
	qcom,battery-beta = <4050>;
	qcom,battery-type = "1308-1851-1";
	qcom,checksum = <0xB505>;
	qcom,gui-version = "PM660GUI - 0.0.0.45";
	qcom,fg-profile-data = [
		 95 1F C3 05
		 19 0A 8B FD
		 6A 1C 8D 02
		 45 0D A1 0A
		 1A 18 AF 22
		 05 3C 0E 52
		 7F 00 00 00
		 14 00 00 00
		 00 00 57 AD
		 DE CC AD CA
		 2E 00 08 00
		 F1 DC 1B DD
		 5D FC 22 F3
		 81 06 FB 02
		 59 FC 13 3A
		 18 06 09 20
		 27 00 14 00
		 C2 1F AA 05
		 3C 0A 91 06
		 5B 1C 78 03
		 D1 15 26 12
		 69 18 01 23
		 59 45 4D 53
		 70 00 00 00
		 11 00 00 00
		 00 00 CA CD
		 A7 CA D3 C5
		 26 00 00 00
		 37 EA 1B DD
		 9B FC C2 F2
		 E1 FD 30 03
		 3B D4 8E 12
		 99 33 CC FF
		 07 10 00 00
		 9D 0A 5C 45
		 26 00 40 00
		 89 01 0A FA
		 FF 00 00 00
		 00 00 00 00
		 00 00 00 00
		 00 00 00 00
		 00 00 00 00
		 00 00 00 00
		 00 00 00 00
		 00 00 00 00
		 00 00 00 00
		 00 00 00 00
		 00 00 00 00
		 00 00 00 00
		 00 00 00 00
		 00 00 00 00
		 00 00 00 00
		 00 00 00 00
		 00 00 00 00
		 00 00 00 00
		 00 00 00 00
	];
	somc,step-cfg = <
		(-2550) 50    0 4500    0 4340 1
		   50  100    0 4500  800 4340 2
		  100  450    0 4250 2025 4340 3
		  100  450 4250 4300 1350 4340 3
		  100  450 4300 4500  800 4340 3
		  450  550    0 4500  800 4200 4
		  550 2550    0 4500    0 4200 5
	>;
	somc,step-cell-impedance-mohm = <25>;
};
